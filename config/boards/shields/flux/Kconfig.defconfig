## config/boards/shields/helix/Kconfig.defconfig
```kconfig
if SHIELD_FLUX_LEFT

config ZMK_KEYBOARD_NAME
    default "Flux KB"

config ZMK_SPLIT_ROLE_CENTRAL
    default y

endif

if SHIELD_FLUX_LEFT || SHIELD_FLUX_RIGHT

config ZMK_SPLIT
    default y

endif
```

## config/boards/shields/helix/Kconfig.shield
```kconfig
config SHIELD_FLUX_LEFT
    def_bool $(shields_list_contains,my_board_left)

config SHIELD_FLUX_RIGHT
    def_bool $(shields_list_contains,my_board_right)
```

## config/boards/shields/kyria/Kconfig.shield
```kconfig
# Copyright (c) 2021 The ZMK Contributors
# SPDX-License-Identifier: MIT


config SHIELD_KYRIA_LEFT
	def_bool $(shields_list_contains,kyria_left)

config SHIELD_KYRIA_RIGHT
	def_bool $(shields_list_contains,kyria_right)
```

## config/boards/shields/obama/Kconfig.defconfig
```kconfig
# Copyright (c) 2020 The ZMK Contributors
# SPDX-License-Identifier: MIT

if SHIELD_OBAMA_LEFT

config ZMK_KEYBOARD_NAME
    default "Obama"

config ZMK_SPLIT_ROLE_CENTRAL
    default y

endif

if SHIELD_OBAMA_LEFT || SHIELD_OBAMA_RIGHT

config ZMK_SPLIT
    default y

endif
```

## config/boards/shields/obama/Kconfig.shield
```kconfig
# Copyright (c) 2020 The ZMK Contributors
# SPDX-License-Identifier: MIT

config SHIELD_OBAMA_LEFT
    def_bool $(shields_list_contains,obama_left)

config SHIELD_OBAMA_RIGHT
    def_bool $(shields_list_contains,obama_right)
```
